#pragma once
#include "Arduino.h"
#include "ESP32-HUB75-MatrixPanel-I2S-DMA.h"

static void drawGlyph4x6(MatrixPanel_I2S_DMA* display, int16_t x, int16_t y, char c, uint16_t color) {
  const uint8_t* glyph = nullptr;

  switch (c) {
    case '0': { static const uint8_t g[6] PROGMEM = {0x6,0x9,0x9,0x9,0x9,0x6}; glyph = g; break; }
    case '1': { static const uint8_t g[6] PROGMEM = {0x4,0xC,0x4,0x4,0x4,0xE}; glyph = g; break; }
    case '2': { static const uint8_t g[6] PROGMEM = {0x6,0x9,0x1,0x2,0x4,0xF}; glyph = g; break; }
    case '3': { static const uint8_t g[6] PROGMEM = {0xE,0x1,0x6,0x1,0x9,0x6}; glyph = g; break; }
    case '4': { static const uint8_t g[6] PROGMEM = {0x2,0x6,0xA,0xF,0x2,0x2}; glyph = g; break; }
    case '5': { static const uint8_t g[6] PROGMEM = {0xF,0x8,0xE,0x1,0x9,0x6}; glyph = g; break; }
    case '6': { static const uint8_t g[6] PROGMEM = {0x6,0x8,0xE,0x9,0x9,0x6}; glyph = g; break; }
    case '7': { static const uint8_t g[6] PROGMEM = {0xF,0x1,0x2,0x4,0x4,0x4}; glyph = g; break; }
    case '8': { static const uint8_t g[6] PROGMEM = {0x6,0x9,0x6,0x9,0x9,0x6}; glyph = g; break; }
    case '9': { static const uint8_t g[6] PROGMEM = {0x6,0x9,0x9,0x7,0x1,0x6}; glyph = g; break; }

    case 'A': { static const uint8_t g[6] PROGMEM = {0x6,0x9,0x9,0xF,0x9,0x9}; glyph = g; break; }
    case 'B': { static const uint8_t g[6] PROGMEM = {0xE,0x9,0xE,0x9,0x9,0xE}; glyph = g; break; }
    case 'C': { static const uint8_t g[6] PROGMEM = {0x6,0x9,0x8,0x8,0x9,0x6}; glyph = g; break; }
    case 'D': { static const uint8_t g[6] PROGMEM = {0xE,0x9,0x9,0x9,0x9,0xE}; glyph = g; break; }
    case 'E': { static const uint8_t g[6] PROGMEM = {0xF,0x8,0xE,0x8,0x8,0xF}; glyph = g; break; }
    case 'F': { static const uint8_t g[6] PROGMEM = {0xF,0x8,0xE,0x8,0x8,0x8}; glyph = g; break; }
    case 'G': { static const uint8_t g[6] PROGMEM = {0x6,0x9,0x8,0xB,0x9,0x7}; glyph = g; break; }
    case 'H': { static const uint8_t g[6] PROGMEM = {0x9,0x9,0xF,0x9,0x9,0x9}; glyph = g; break; }
    case 'I': { static const uint8_t g[6] PROGMEM = {0xE,0x4,0x4,0x4,0x4,0xE}; glyph = g; break; }
    case 'J': { static const uint8_t g[6] PROGMEM = {0x3,0x1,0x1,0x9,0x9,0x6}; glyph = g; break; }
    case 'K': { static const uint8_t g[6] PROGMEM = {0x9,0xA,0xC,0xA,0xA,0x9}; glyph = g; break; }
    case 'L': { static const uint8_t g[6] PROGMEM = {0x8,0x8,0x8,0x8,0x8,0xF}; glyph = g; break; }
    case 'M': { static const uint8_t g[6] PROGMEM = {0x9,0xF,0xF,0x9,0x9,0x9}; glyph = g; break; }
    case 'N': { static const uint8_t g[6] PROGMEM = {0x9,0xD,0xB,0x9,0x9,0x9}; glyph = g; break; }
    case 'O': { static const uint8_t g[6] PROGMEM = {0x6,0x9,0x9,0x9,0x9,0x6}; glyph = g; break; }
    case 'P': { static const uint8_t g[6] PROGMEM = {0xE,0x9,0x9,0xE,0x8,0x8}; glyph = g; break; }
    case 'Q': { static const uint8_t g[6] PROGMEM = {0x6,0x9,0x9,0x9,0xB,0x7}; glyph = g; break; }
    case 'R': { static const uint8_t g[6] PROGMEM = {0xE,0x9,0x9,0xE,0xA,0x9}; glyph = g; break; }
    case 'S': { static const uint8_t g[6] PROGMEM = {0x7,0x8,0x6,0x1,0x1,0xE}; glyph = g; break; }
    case 'T': { static const uint8_t g[6] PROGMEM = {0xF,0x4,0x4,0x4,0x4,0x4}; glyph = g; break; }
    case 'U': { static const uint8_t g[6] PROGMEM = {0x9,0x9,0x9,0x9,0x9,0x6}; glyph = g; break; }
    case 'V': { static const uint8_t g[6] PROGMEM = {0x9,0x9,0x9,0x9,0x6,0x6}; glyph = g; break; }
    case 'W': { static const uint8_t g[6] PROGMEM = {0x9,0x9,0x9,0xF,0xF,0x9}; glyph = g; break; }
    case 'X': { static const uint8_t g[6] PROGMEM = {0x9,0x9,0x6,0x6,0x9,0x9}; glyph = g; break; }
    case 'Y': { static const uint8_t g[6] PROGMEM = {0x9,0x9,0x6,0x4,0x4,0x4}; glyph = g; break; }
    case 'Z': { static const uint8_t g[6] PROGMEM = {0xF,0x1,0x2,0x4,0x8,0xF}; glyph = g; break; }

    case ':': { static const uint8_t g[6] PROGMEM = {0x0,0x4,0x0,0x0,0x4,0x0}; glyph = g; break; }
    case ';': { static const uint8_t g[6] PROGMEM = {0x0,0x4,0x0,0x0,0x4,0x8}; glyph = g; break; }
    case '.': { static const uint8_t g[6] PROGMEM = {0x0,0x0,0x0,0x0,0x0,0x4}; glyph = g; break; }
    case ',': { static const uint8_t g[6] PROGMEM = {0x0,0x0,0x0,0x0,0x4,0x8}; glyph = g; break; }
    case '-': { static const uint8_t g[6] PROGMEM = {0x0,0x0,0xE,0x0,0x0,0x0}; glyph = g; break; }
    case '_': { static const uint8_t g[6] PROGMEM = {0x0,0x0,0x0,0x0,0x0,0xF}; glyph = g; break; }
    case '/': { static const uint8_t g[6] PROGMEM = {0x1,0x2,0x4,0x8,0x0,0x0}; glyph = g; break; }
    case ' ': { static const uint8_t g[6] PROGMEM = {0x0,0x0,0x0,0x0,0x0,0x0}; glyph = g; break; }

    default:  { static const uint8_t g[6] PROGMEM = {0x0,0x0,0x0,0x0,0x0,0x0}; glyph = g; break; }
  }

  for (int row = 0; row < 6; row++) {
    uint8_t bits = pgm_read_byte(&glyph[row]);
    for (int col = 0; col < 4; col++) {
      if (bits & (1 << (3 - col))) {
        display->drawPixel(x + col, y + row, color);
      }
    }
  }
}

static void drawText4x6(MatrixPanel_I2S_DMA* display, int16_t x, int16_t y, const char* s, uint16_t color) {
  while (*s) {
    drawGlyph4x6(display, x, y, *s, color);
    x += 5; // 4 pixels wide + 1 spacing
    s++;
  }
}
